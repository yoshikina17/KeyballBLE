## config/west.yml
```yaml
manifest:
  remotes:
    - name: cormoran
      url-base: https://github.com/cormoran
    - name: sayu-hub  # pmw3610-driver のフォーク
      url-base: https://github.com/sayu-hub

  projects:
    - name: zmk
      remote: cormoran
      revision: v0.3-branch+dya
      import: app/west.yml
    # DYA Studio モジュール
    - name: zmk-module-ble-management
      remote: cormoran
      revision: main
    - name: zmk-module-battery-history
      remote: cormoran
      revision: main
    - name: zmk-module-settings-rpc
      remote: cormoran
      revision: main
    - name: zmk-module-runtime-input-processor
      remote: cormoran
      revision: main
    # PMW3610 トラックボールドライバー
    - name: zmk-pmw3610-driver
      remote: sayu-hub
      revision: main
  self:
    path: config
```
